## applications/blackmagic-rtthread/Kconfig
```kconfig
# Kconfig file for package blackmagic
menuconfig PKG_USING_BLACKMAGIC
    bool "black magic probe: arm debugger probe"
    default n

if PKG_USING_BLACKMAGIC

    menu "Timing"
    config BLACKMAGIC_DELAY_CONSTANT
        int "delay constant"
        default 10000
        help
            This is the number of delay loop iterations at which SWCLK frequency is 1kHz.
            This constant can be determined by calling clock_test(i) with varying parameter value and measuring the frequency on the SWCLK pin.

    config BLACKMAGIC_FASTCLOCK
        int "fast clock in Hz"
        default 2500000
        help
            This is the frequency (in Hz) produced on the SWCLK pin when running clock_test(1).
            You can also measure maximum achievable frequency by running clock_test(0).

    endmenu

    config BLACKMAGIC_ENABLE_RTT
        bool "rtt support"
        default y
        help
            rtt (real-time terminal) allows terminal input/output between target and host at a very high speed without affecting the target's real time behavior.

    config BLACKMAGIC_ENABLE_RTT_IDENT
        bool "rtt ident"
        depends on BLACKMAGIC_ENABLE_RTT
        default n
        help
            set optional rtt secret.

    config BLACKMAGIC_RTT_IDENT
        string "rtt ident"
        depends on BLACKMAGIC_ENABLE_RTT_IDENT
        default ""
        help
            optional rtt secret. '%' is converted to ' ' space.

    config BLACKMAGIC_ENABLE_MEMWATCH
        bool "memwatch support"
        default y
        help
            memwatch reads target memory while the target is running.
            Inspecting memory without halting the target is useful when debugging hard real time systems.

    config BLACKMAGIC_ENABLE_DEBUG
        bool "debug output"
        default n
        help
            If enabled, debug output is written to the aux port.
            Useful when debugging blackmagic probe.

    config BLACKMAGIC_ENABLE_NO_ACK_MODE
        bool "advertise gdb \"No Ack Mode\""
        default y
        help
            Advertises gdb "no ack mode"

    config PKG_BLACKMAGIC_VER
       string
       default "v1.10"    if PKG_USING_BLACKMAGIC_V110
       default "latest"   if PKG_USING_BLACKMAGIC_LATEST_VERSION

endif
```
